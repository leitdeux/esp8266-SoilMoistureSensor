/* soilStatus.ino
 * 
 * Elliott Fiedler
 * https://github.com/3MF
 *
 * Computer Science 50
 * Final Project
 *
 * Tested Hardware: WeMos D1 Mini, with WeMos 64x48-pixel OLED Shield and YL-69/YL-38 soil hygrometer sensor
 * 
 * Connects to local WiFi network, measures soil moisture, displays status via OLED, and 
 * updates database via GET request to server.
 * 
*/

#include <Adafruit_GFX.h>
#include <Adafruit_SSD1306.h>
#include <ESP8266WiFi.h>
#include <math.h>
#include <SPI.h>
#include <WiFiClient.h>
#include <Wire.h>

#include "soilStatus.h"

// WiFi
const char* ssid = "SSID";
const char* password = "PASSWORD";
const char* host = "HOST";

// YL-38 (VCC, GND, A0 and D0) to Wemos D1 Mini (5V, GND, A0, and D5)
#define ANALOG_PIN A0
#define DIGITAL_PIN D5

// OLED display
#define OLED_RESET 0
Adafruit_SSD1306 display(OLED_RESET);

// Adafruit_SSD1306.h with support for 64x48 OLED displays:
// https://github.com/mcauser/Adafruit_SSD1306/tree/esp8266-64x48
#if (SSD1306_LCDHEIGHT != 48)
#error("Height incorrect (https://github.com/mcauser/Adafruit_SSD1306/tree/esp8266-64x48)");
#endif

// happy flower bitmap (64 x 48)
static const unsigned char PROGMEM happy_flower_bmp [] = {
    0x00, 0x00, 0x00, 0x00, 0x00, 0x00, 0x00, 0x00, 0x00, 0x00, 0x00, 0x00, 0x00, 0x00, 0x00, 0x00, 
    0x00, 0x00, 0x00, 0x00, 0x00, 0x00, 0x00, 0x00, 0x00, 0x00, 0x00, 0x03, 0xe0, 0x00, 0x00, 0x00, 
    0x00, 0x00, 0x00, 0x07, 0xf0, 0x00, 0x00, 0x00, 0x00, 0x00, 0x00, 0x07, 0xf8, 0x00, 0x00, 0x00, 
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    0x00, 0x00, 0x00, 0x00, 0x00, 0x00, 0x00, 0x00, 0x00, 0x00, 0x00, 0x00, 0x00, 0x00, 0x00, 0x00 
};

// sad face bitmap
static const unsigned char PROGMEM sad_face_bmp [] = {
    0x00, 0x00, 0x00, 0x00, 0x00, 0x00, 0x00, 0x00, 0x00, 0x00, 0x00, 0x3f, 0xfc, 0x00, 0x00, 0x00, 
    0x00, 0x00, 0x01, 0xff, 0xff, 0x80, 0x00, 0x00, 0x00, 0x00, 0x07, 0xf0, 0x0f, 0xe0, 0x00, 0x00, 
    0x00, 0x00, 0x1f, 0x00, 0x00, 0xf8, 0x00, 0x00, 0x00, 0x00, 0x3c, 0x00, 0x00, 0x3c, 0x00, 0x00, 
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    0x00, 0x00, 0x00, 0x3f, 0xfc, 0x00, 0x00, 0x00, 0x00, 0x00, 0x00, 0x00, 0x00, 0x00, 0x00, 0x00
};

// soil status struct
soil_state* soilState = new soil_state;

// time to sleep (in seconds)
const int sleepTime = 7200; // read once every 1 hr.

void setup() {
    // set baud rate
    Serial.begin(9600);
    Serial.println("");

    // reset built-in LED on board
    pinMode(BUILTIN_LED, OUTPUT);
    digitalWrite(BUILTIN_LED, LOW);
    
    // set analog pin 0 to be input from moisture sensor
    pinMode(ANALOG_PIN, INPUT);
    
    // set digital pin used to power-up/-down sensor
    pinMode(DIGITAL_PIN, OUTPUT);
    digitalWrite(DIGITAL_PIN, LOW);

    // init display
    display.begin(SSD1306_SWITCHCAPVCC, 0x3C);
    display.clearDisplay();
    delay(500);
}

void loop() {
    
    // get reading of soil moisture via YL-69/YL-38
    int sample = readMoisture(soilState);

    // display visual feedback
    displayState(soilState, sample);

    // update reading on server
    updateServer(sample);
    
    delete soilState;
    soilState = nullptr;

    // power-down sensor until next reading
    Serial.println("I'm going to sleep...");
    ESP.deepSleep(sleepTime * 1000000);
}

// take sample of soil moisture via YL-69 sensor
int readMoisture(soil_state* status) {
    
    int moisture = 0;
    
    // power up YL-69 sensor before reading
    digitalWrite(DIGITAL_PIN, HIGH);
    delay(500);
    
    // take a moisture sample
    int s = analogRead(ANALOG_PIN);
    digitalWrite(DIGITAL_PIN, LOW);

    Serial.print("Current reading: ");
    Serial.print(s);
    Serial.print(" - ");

    if (s >= 1000) {
        status->error = true;
        Serial.println("Soil not detected");
        return moisture;
    }
    else if (s < 1000 && s >= 600) {
        status->dry = true;
        Serial.println("Soil is dry");
    }
    else if (s < 600 && s >= 370) {
        status->humid = true;
        Serial.println("Soil is humid");
    }
    else if (s < 370) {
        status->water = true;
        Serial.println("Sensor is in water");
        return moisture;
    }
    /* convert reading to moisture percentage:
     * "1024" is 0% moisture (100% dryness)
     * moisture percentage = (1 - (s / 1024)) * 100)
     */
    float f = 1.0 - ((float) s / 1024.0);
    moisture = (int) ((f) * 100.0);
    
    return moisture;
}

// visual feedback of moisture status
void displayState(soil_state* status, int reading) {

    if (status->error == true) {
        showError();
        showError();
        showError();
        Serial.println("Please place sensor in soil.");
    }
    else if (status->dry == true) {
        display.drawBitmap(0, 0, sad_face_bmp, 64, 48, 1);
        display.display();
    }
    else if (status->humid == true) {
        display.drawBitmap(0, 0, happy_flower_bmp, 64, 48, 1);
        display.display();
    }
    else if (status->water == true) {
        showError();
        showError();
        showError();
        Serial.println("Sensor is in water");
    }
    delay(10000);

    // display moisture percent
    if (status->dry == true || status->humid == true)
        showReading(reading);
    display.clearDisplay();
}

void updateServer(int value) {
    // connect to local WiFi network
    WiFi.disconnect();
    WiFi.mode(WIFI_STA);
    WiFi.begin(ssid, password);
    delay(100);

    Serial.print("Connecting to ");
    Serial.print(ssid);
    while (WiFi.status() != WL_CONNECTED) {
        digitalWrite(BUILTIN_LED, LOW);
        delay(500);
        Serial.print(".");
        digitalWrite(BUILTIN_LED, HIGH);
        delay(500);
    }
    Serial.println("");
    Serial.println("Success!");
    Serial.print("IP address: ");
    Serial.println(WiFi.localIP());

    // use WiFiClient class to create a TCP connection
    WiFiClient client;
    const int port = 80;
    if (!client.connect(host, port)) {
        Serial.println("Connection failed.");
        delay(5000);
        return;
    }

    String url = "/public/update.php?humidity="; 
    url += value;
    Serial.print("Requesting URL: ");
    Serial.println(host + url);
    
    // send the request to the server
    client.print(String("GET ") + url + " HTTP/1.1\r\n" +
                        "Host: " + host + "\r\n" +
                        "Connection: close\r\n\r\n");
    
    // get confirmation from server
    Serial.println("Response:");
    while(client.connected()) {
        String line = client.readStringUntil('\r\n'); // get 200 OK response
        Serial.print(line);
    }
    delay(100);
    
    // check request failed
    if (!client.connected())
        Serial.println("Not connected.");

    WiFi.disconnect();
    delay(2000);
}

// display current reading
void showReading(int moisture) {
    printTitle("Moisture:", 1);
    printReading(moisture, 3);
    display.print("\%");
    display.display();
    delay(2500);
}

// display "?" when sensor is not in soil or immersed in water
void showError() {
    display.clearDisplay();
    display.setTextSize(3);
    display.setTextColor(WHITE);
    display.setCursor(24, 20);
    display.print("?");
    display.display();
    delay(2000);
}

// title header appearing above measurement
void printTitle(String title, int font) {
    display.clearDisplay();
    display.setTextSize(font);
    display.setTextColor(WHITE);
    display.setCursor(0, 0);
    
    // print title
    display.println("Current");
    display.print(title);
    display.display();
}

// print moisture value with appropriate text settings
void printReading(int value, int font) {
    display.setTextSize(font);
    display.setTextColor(WHITE);
    display.setCursor(0, 20);
    
    // print moisture value
    display.print(value);
    display.display();
}